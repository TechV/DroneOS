## DroneOS/buildroot/package/bluez5_utils/Config.in
```kconfig
config BR2_PACKAGE_BLUEZ5_UTILS 
	bool "bluez-utils 5.x" 
	depends on !BR2_avr32 
	depends on BR2_USE_WCHAR # libglib2 
	depends on BR2_TOOLCHAIN_HAS_THREADS # dbus, libglib2 
	depends on BR2_USE_MMU # dbus 
	depends on !BR2_PACKAGE_BLUEZ_UTILS # conflicts with 4.x version 
	select BR2_PACKAGE_DBUS 
	select BR2_PACKAGE_LIBGLIB2 
	select BR2_PACKAGE_LIBICAL 
	select BR2_PACKAGE_READLINE 
	help 
	  bluez utils version 5.x 
 
	  With this release BlueZ only supports the new Bluetooth Management 
	  kernel interface (introduced in Linux 3.4). 
	  For Low Energy support at least kernel version 3.5 is needed. 
 
	  The API is not backwards compatible with BlueZ 4. 
 
	  Bluez utils will use systemd and/or udev if enabled. 
 
	  http://www.bluez.org
	  http://www.kernel.org/pub/linux/bluetooth
 
if BR2_PACKAGE_BLUEZ5_UTILS 
 
config BR2_PACKAGE_BLUEZ5_UTILS_EXPERIMENTAL 
	bool "build experimental plugins" 
	help 
	  Build BlueZ 5.x experimental plugins (SAP, NFC, ...). 
 
config BR2_PACKAGE_BLUEZ5_UTILS_TEST 
	bool "enable test" 
	help 
	  Enable test. 
 
config BR2_PACKAGE_BLUEZ5_UTILS_GATTTOOL 
	bool "install GATT tool" 
	help 
	  Generic Attribute Profile (GATT) support. This provides profile 
	  discovery and description services for Bluetooth Low Energy. 
	  This will install the gatttool utility. 
 
	  It is always build with BlueZ 5.x, but upstream choose not to install 
	  it by default. 
 
endif 
 
comment "bluez5-utils needs a toolchain w/ wchar, threads" 
	depends on !BR2_USE_WCHAR || !BR2_TOOLCHAIN_HAS_THREADS 
 
comment "bluez5-utils conflicts with older bluez-utils version" 
	depends on BR2_PACKAGE_BLUEZ_UTILS 
```

## DroneOS/buildroot/package/rpicopter/Config.in
```kconfig
config BR2_PACKAGE_RPICOPTER
	bool "rpicopter"
	help
	  Adds rpicopter utils package
          forked from
	  https://github.com/rpicopter 

if BR2_PACKAGE_RPICOPTER
source "package/rpicopter/rpic-controller/Config.in"
source "package/rpicopter/rpic-avrcontroller/Config.in"
source "package/rpicopter/rpic-bluez-tools/Config.in"
source "package/rpicopter/rpic-utils/Config.in"
source "package/rpicopter/rpic-pigpio/Config.in"
source "package/rpicopter/rpic-servoblaster/Config.in"
source "package/rpicopter/rpic-qtsixa/Config.in"
endif
```

## DroneOS/buildroot/package/rpicopter/MotionSensorExample/Config.in
```kconfig
config BR2_PACKAGE_RPIC_UTILS
	bool "rpic-MotionSensorExample"
#	select BR2_PACKAGE_BLUEZ_UTILS_COMPAT
#	select BR2_PACKAGE_UDEV
	help
	  Adds MotionSensorExample package
	  https://github.com/rpicopter/MotionSensorExample
```

## DroneOS/buildroot/package/rpicopter/rpic-avrcontroller/Config.in
```kconfig
config BR2_PACKAGE_RPIC_AVRCONTROLLER
	bool "rpic-avrcontroller"
	help
	  Adds avr controller package
	  https://github.com/rpicopter/avrcontroller
```

## DroneOS/buildroot/package/rpicopter/rpic-bluez-tools/Config.in
```kconfig
config BR2_PACKAGE_RPIC_BLUEZ_TOOLS
    bool "rpic-bluez-tools"
    depends on BR2_PACKAGE_DBUS_GLIB
    depends on BR2_PACKAGE_READLINE
    help
        bluez-tools
        https://github.com/rpicopter/bluez-tools
```

## DroneOS/buildroot/package/rpicopter/rpic-controller/Config.in
```kconfig
config BR2_PACKAGE_RPIC_CONTROLLER
	bool "rpic-controller"
	help
	  Adds controller package
	  https://github.com/rpicopter/controller
```

## DroneOS/buildroot/package/rpicopter/rpic-pigpio/Config.in
```kconfig
config BR2_PACKAGE_RPIC_PIGPIO
	bool "rpic-pigpio"
	help
	  Adds pigpio package
	  https://github.com/rpicopter/pigpio
```

## DroneOS/buildroot/package/rpicopter/rpic-qtsixa/Config.in
```kconfig
config BR2_PACKAGE_RPIC_QTSIXA
	bool "rpic-qtsixa"
	depends on BR2_PACKAGE_LIBUSB_COMPAT
	help
	  Adds support for PS3 SixAxis controller
	  https://github.com/rpicopter/QtSixA 
```

## DroneOS/buildroot/package/rpicopter/rpic-servoblaster/Config.in
```kconfig
config BR2_PACKAGE_RPIC_SERVOBLASTER
	bool "rpic-servoblaster"
	help
	  Adds servoblaster
	  https://github.com/rpicopter/ServoBlaster
```

## DroneOS/buildroot/package/rpicopter/rpic-utils/Config.in
```kconfig
config BR2_PACKAGE_RPIC_UTILS
	bool "rpic-utils"
#	select BR2_PACKAGE_BLUEZ_UTILS_COMPAT
#	select BR2_PACKAGE_UDEV
	help
	  Adds utils package
	  https://github.com/rpicopter/utils
```
